/*@!Encoding:1252*/
includes
{
  
  #include "diag.cin"
}

variables
{
  
}

on key 'm'{
  DiagnosticSessionControl(EXTENDED_SESSION);
}

