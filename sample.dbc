VERSION ""

NS_ :

BS_:

BU_: BCM IPC

BO_ 42 TemperatureStatus: 1 BCM
 SG_ SensorValue : 0|8@1+ (1,0) [0|255] "" Vector__XXX

BO_ 26 TellTale: 1 IPC
 SG_ TemperatureAlarm : 1|1@1+ (1,0) [0|1] "" Vector__XXX
 SG_ SeatBeltWarning : 0|1@1+ (1,0) [0|1] "" Vector__XXX
